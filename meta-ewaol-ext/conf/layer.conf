## meta-ewaol-ext/conf/layer.conf
```bitbake
# Copyright Amazon.com, Inc. or its affiliates. All Rights Reserved.
# SPDX-License-Identifier: MIT-0
# We have a conf and classes directory, add to BBPATH
BBPATH .= ":${LAYERDIR}"

# We have recipes-* directories, add to BBFILES
BBFILES += "${LAYERDIR}/recipes-*/*/*.bb \
            ${LAYERDIR}/recipes-*/*/*.bbappend"

BBFILE_COLLECTIONS += "ewaol-ext"
BBFILE_PATTERN_ewaol-ext = "^${LAYERDIR}/"
BBFILE_PRIORITY_ewaol-ext = "6"
LAYERVERSION_ewaol-ext = "1"
LAYERSERIES_COMPAT_ewaol-ext = "hardknott"
LAYERDEPENDS_ewaol-ext = " \
    virtualization-layer\
    yocto\
"
```
